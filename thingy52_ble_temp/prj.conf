## CMakeLists.txt
```
# SPDX-License-Identifier: Apache-2.0
cmake_minimum_required(VERSION 3.20.0)

# set board variable to thingy:52 for cross-compilation, needs to be done before including/finding zephyr
set(BOARD "thingy52_nrf52832")

find_package(Zephyr REQUIRED HINTS $ENV{ZEPHYR_BASE})

project(ble_gatt_server)

target_sources(app PRIVATE src/main.c src/status_blinker.c src/ble_hts.c src/hts221_reader.c)
```

## prj.conf
```kconfig
CONFIG_USE_SEGGER_RTT=y
CONFIG_RTT_CONSOLE=y

CONFIG_I2C=y
CONFIG_SENSOR=y

CONFIG_BT=y
CONFIG_BT_PERIPHERAL=y
CONFIG_BT_DEVICE_NAME_DYNAMIC=y
CONFIG_BT_DEVICE_NAME="Group4 Thingy52"
```

## src/main.c
```c
#include <zephyr/kernel.h>
#include <zephyr/device.h>
#include <zephyr/devicetree.h>
#include <zephyr/drivers/gpio.h>

#include <zephyr/logging/log.h>

#include "status_blinker.h"
#include "ble_hts.h"
#include "hts221_reader.h"

#include "stdio.h"

#define IND_NOTY_PERIOD 5000 // 5 seconds

//  Get device tree data for status leds and hts221 sensor
#define LED_R_NODE  DT_NODELABEL(led0)
#define LED_G_NODE  DT_NODELABEL(led1)
#define HTS221_NODE DT_NODELABEL(hts221)
#if (DT_NODE_HAS_STATUS(LED_R_NODE, okay) && DT_NODE_HAS_STATUS(LED_G_NODE, okay) &&               \
     DT_NODE_HAS_STATUS(HTS221_NODE, okay))

struct gpio_dt_spec led_r = GPIO_DT_SPEC_GET(LED_R_NODE, gpios);
struct gpio_dt_spec led_g = GPIO_DT_SPEC_GET(LED_G_NODE, gpios);
const struct device *hts221_dev = DEVICE_DT_GET(HTS221_NODE);

#else
#error "Failed to get the node ids of the devices from the device tree, check their statuses"
#endif

struct gpio_dt_spec *led_to_blink = NULL;
K_MUTEX_DEFINE(led_mutex);

// boolean flag that is set when a remote enddpoint is subscribed
// to Temperature Measurement characteristic indication
// or Intermediate Temperature chracteristic notificateion
// of HT service or Intermeditace
extern bool do_indicate_tm_char;
extern bool do_notify_it_char;
extern bool do_indicate_hum_char;

int main()
{
	int err;

	// Initialize status led, start status update thread
	err = init_status_blinker();
	if (err) {
		printk("Status blinker initialization failed (err %d)\n", err);
		return err;
	}

	if (!device_is_ready(hts221_dev)) {
		printk("HTS 221 initialization failed (err %d)\n", err);
		return err;
	}

	// Initialize ble module
	err = init_ble_hts();
	if (err) {
		printk("Bluetooth init failed (err %d)\n", err);
		return err;
	}

	while (true) {

		printk("Bluetooth initialized\n");

		if (do_indicate_tm_char || do_notify_it_char || do_indicate_hum_char) {
			double temp, humidity;
			if ((err = hts221_get_sample(&temp)) != 0) {
				printk("hts221_get_sample failed (err %d)\n", err);
				return err;
			}

			printk("Temperature: %f\n", temp);
			printk("Humidity: %f\n", humidity);

			if (do_indicate_tm_char) {
				do_indicate_temperture_measurement(&temp);
			}
			if (do_notify_it_char) {
				do_notify_intermediate_temperature(&temp);
			}
			if (do_indicate_hum_char) {
				do_indicate_humidity_measurement(&humidity);
			}
		}

		k_msleep(IND_NOTY_PERIOD);
	}

	return 0;
}
```

## src/ble_hts.c
```c
#include <zephyr/drivers/gpio.h>
#include <zephyr/bluetooth/bluetooth.h>
#include <zephyr/bluetooth/conn.h>
#include <zephyr/bluetooth/gatt.h>
#include <zephyr/sys/byteorder.h>

#include "hts221_reader.h"
#include "ble_hts.h"

// Used across multiple modules, defined in main.cpp
extern struct gpio_dt_spec led_r;
extern struct gpio_dt_spec led_g;
extern struct gpio_dt_spec *led_to_blink;
extern struct k_mutex led_mutex;

// Flags that are set when a client subscribes to notifications/inidcations
bool do_indicate_tm_char = false;
bool do_notify_it_char = false;

bool do_indicate_hum_char = false;

// Define on connection open/close callbacks
BT_CONN_CB_DEFINE(conn_callbacks) = {
	.connected = on_conn_open,
	.disconnected = on_conn_close,
};

// Advertisment data with flats general dicoverable + no BREDR (=only ble) and Health Thermometer
// Service
static const struct bt_data ad[] = {
	BT_DATA_BYTES(BT_DATA_FLAGS, (BT_LE_AD_GENERAL | BT_LE_AD_NO_BREDR)),
	BT_DATA_BYTES(BT_DATA_UUID16_ALL, BT_UUID_16_ENCODE(BT_UUID_HTS_VAL))};

// BLE characteristic read callback
static ssize_t read_temp_request(struct bt_conn *conn, const struct bt_gatt_attr *attr, void *buf,
				 uint16_t len, uint16_t offset)
{
	double temp, humidity;

	int err;
	if ((err = hts221_get_sample(&temp)) != 0) {
		printk("hts221_get_sample failed (err %d)\n", err);
		return err;
	}
	static uint8_t data[5];
	encode_temp_char(&temp, data);

	return bt_gatt_attr_read(conn, attr, buf, len, offset, &data, sizeof(data));
}

// BLE characteristic read callback
static ssize_t read_humidity_request(struct bt_conn *conn, const struct bt_gatt_attr *attr,
				     void *buf, uint16_t len, uint16_t offset)
{
	double temp, humidity;

	int err;
	if ((err = hts221_get_sample(&temp)) != 0) {
		printk("hts221_get_sample failed (err %d)\n", err);
		return err;
	}
	const uint8_t hum = (uint8_t)humidity;
	uint8_t data[2] = {hum, 0};
	// encode_temp_char(&temp, data);

	return bt_gatt_attr_read(conn, attr, buf, len, offset, &data, sizeof(data));
}

// UUID for optional Intemediate Teperature characteristic
#define BT_UUID_INTERMEDIATE_TEMP_VAL 0x2a1e
#define BT_UUID_INTERMEDIATE_TEMP     BT_UUID_DECLARE_16(BT_UUID_INTERMEDIATE_TEMP_VAL)

/* Health Thermometer Service Declaration */
BT_GATT_SERVICE_DEFINE(
	hts_service, BT_GATT_PRIMARY_SERVICE(BT_UUID_HTS),

	// Mandatory: Temperature Measurement characteristic with possibility to read it
	BT_GATT_CHARACTERISTIC(BT_UUID_HTS_MEASUREMENT, BT_GATT_CHRC_INDICATE | BT_GATT_CHRC_READ,
			       BT_GATT_PERM_READ, read_temp_request, NULL, NULL),
	BT_GATT_CCC(temp_measurement_ccc_changed_callback, BT_GATT_PERM_READ | BT_GATT_PERM_WRITE),

	// // Mandatory: Humidity Measurement characteristic with possibility to read it
	// BT_GATT_CHARACTERISTIC(BT_UUID_HUMIDITY, BT_GATT_CHRC_INDICATE | BT_GATT_CHRC_READ,
	// 		       BT_GATT_PERM_READ, read_humidity_request, NULL, NULL),
	// BT_GATT_CCC(humidity_measurement_ccc_changed_callback,
	// 	    BT_GATT_PERM_READ | BT_GATT_PERM_WRITE),

	// // Optional: Intermediate Temperature
	BT_GATT_CHARACTERISTIC(BT_UUID_INTERMEDIATE_TEMP, BT_GATT_CHRC_NOTIFY, BT_GATT_PERM_NONE,
			       NULL, NULL, NULL),
	BT_GATT_CCC(intermediate_temp_ccc_changed_callback,
		    BT_GATT_PERM_READ | BT_GATT_PERM_WRITE));

int init_ble_hts()
{
	int err;

	err = bt_enable(ble_ready);
	if (err) {
		printk("Bluetooth init failed (err %d)\n", err);
		return err;
	}

	return 0;
}

void ble_ready()
{
	// Begin advertising
	int err = bt_le_adv_start(BT_LE_ADV_CONN_NAME, ad, ARRAY_SIZE(ad), NULL, 0);
	if (err) {
		printk("Advertising failed to start (err %d)\n", err);
		return;
	} else {
		printk("Started advertising.\n");
	}
}

void on_conn_open(struct bt_conn *conn, uint8_t err)
{
	if (err) {
		printk("Connection failed (err 0x%02x)\n", err);
	} else {
		printk("Connected\n");
	}

	// Lock the led mutex, change blinking led to green, unlock mutex
	k_mutex_lock(&led_mutex, K_FOREVER);
	gpio_pin_set(led_to_blink->port, led_to_blink->pin, 0);
	led_to_blink = &led_g;
	k_mutex_unlock(&led_mutex);
}

void on_conn_close(struct bt_conn *conn, uint8_t reason)
{
	printk("Disconnected (reason 0x%02x)\n", reason);

	do_indicate_tm_char = false;
	do_notify_it_char = false;

	// Lock the led mutex, change blinking led to red, unlock mutex
	k_mutex_lock(&led_mutex, K_FOREVER);
	gpio_pin_set(led_to_blink->port, led_to_blink->pin, 0);
	led_to_blink = &led_r;
	k_mutex_unlock(&led_mutex);
}

void temp_measurement_ccc_changed_callback(const struct bt_gatt_attr *attr, uint16_t value)
{
	do_indicate_tm_char = value == BT_GATT_CCC_INDICATE;
}

void humidity_measurement_ccc_changed_callback(const struct bt_gatt_attr *attr, uint16_t value)
{
	do_indicate_hum_char = value == BT_GATT_CCC_INDICATE;
}

void intermediate_temp_ccc_changed_callback(const struct bt_gatt_attr *attr, uint16_t value)
{
	do_notify_it_char = value == BT_GATT_CCC_NOTIFY;
}

void encode_temp_char(double *temp, char *data)
{
	uint32_t mantissa;
	uint8_t exponent;
	mantissa = (uint32_t)(*temp * 100);
	exponent = (uint8_t)-2;

	// Whole flags byte set to 0:
	// bit 0 - celsius, bit 1:7 - no time stamp, no temp type, reserverd bits set to 0
	data[0] = 0;

	// med float: 1 byte exponent, 4 bytes mantissa
	sys_put_le24(mantissa, (uint8_t *)&data[1]);
	data[4] = exponent;
}

void do_indicate_temperture_measurement(double *temp)
{
	static uint8_t data[5];
	encode_temp_char(temp, data);

	static struct bt_gatt_indicate_params ind_params;
	// CCC attribute pointer (see line 36)
	ind_params.attr = &hts_service.attrs[2];
	// data to indicate
	ind_params.data = &data;
	ind_params.len = sizeof(data);
	// we don't use the Indicate Value callback / Indicate operation complete callback
	// so they remain unitialzied

	bt_gatt_indicate(NULL, &ind_params);
}

void do_notify_intermediate_temperature(double *temp)
{
	static uint8_t data[5];
	encode_temp_char(temp, data);

	// second parameter is out CCC attribute pointer (see line 36)
	bt_gatt_notify(NULL, &hts_service.attrs[4], &data, sizeof(data));
}

void do_indicate_humidity_measurement(double *humidity)
{
	uint8_t data[2] = {(uint8_t)humidity, 0};

	// encode_temp_char(temp, data);

	static struct bt_gatt_indicate_params ind_params;
	// CCC attribute pointer (see line 36)
	ind_params.attr = &hts_service.attrs[2];
	// data to indicate
	ind_params.data = &data;
	ind_params.len = sizeof(data);
	// we don't use the Indicate Value callback / Indicate operation complete callback
	// so they remain unitialzied

	bt_gatt_indicate(NULL, &ind_params);
}
```

## src/ble_hts.h
```c
#ifndef __BLE_HTS_HPP__
#define __BLE_HTS_HPP__

// forward declare structs to supress warning messages
struct bt_conn;
struct bt_gatt_attr;

int init_ble_hts();
void ble_ready();
void on_conn_open(struct bt_conn *conn, uint8_t err);
void on_conn_close(struct bt_conn *conn, uint8_t reason);

void temp_measurement_ccc_changed_callback(const struct bt_gatt_attr *attr, uint16_t value);
void intermediate_temp_ccc_changed_callback(const struct bt_gatt_attr *attr, uint16_t value);
void do_indicate_temperture_measurement(double *temp);
void do_notify_intermediate_temperature(double *temp);

void humidity_measurement_ccc_changed_callback(const struct bt_gatt_attr *attr, uint16_t value);
void do_indicate_humidity_measurement(double *temp);
// void do_notify_intermediate_humidity(double *temp);

#endif
```

## src/hts221_reader.c
```c
#include <zephyr/drivers/sensor.h>

#include "hts221_reader.h"

extern const struct device *hts221_dev;

int hts221_get_sample(double *temperature)
{
	int err;

	if ((err = sensor_sample_fetch(hts221_dev)) != 0) {
		return err;
	}

	struct sensor_value temp_sensor_value;
	if ((err = sensor_channel_get(hts221_dev, SENSOR_CHAN_AMBIENT_TEMP, &temp_sensor_value)) !=
	    0) {
		return err;
	}

	*temperature = sensor_value_to_double(&temp_sensor_value);
	// *humidity = sensor_value_to_double(&humidity_sensor_value);
	return 0;
}
```

## src/hts221_reader.h
```c
#ifndef __HTS221_READER_HPP__
#define __HTS221_READER_HPP__

int hts221_get_sample(double *temperature);

#endif
```

## src/status_blinker.c
```c
#include <zephyr/kernel.h>
#include <zephyr/drivers/gpio.h>

#include "status_blinker.h"

#define STATUS_BLINKER_STACKSIZE 1024   // Thread stack size
#define STATUS_BLINKER_PRIORITY 7       // Thread priority
#define STATUS_BLINKER_SLEEPTIME 500    // Blinker thread sleep time (=period)

// Used across multiple modules, defined in main.cpp
extern struct gpio_dt_spec  led_r;
extern struct gpio_dt_spec  led_g;
extern struct gpio_dt_spec* led_to_blink;
extern struct k_mutex       led_mutex;

// Define blinker thread stack and thread data struct
K_THREAD_STACK_DEFINE(status_blinker_stack, STATUS_BLINKER_STACKSIZE);
static struct k_thread status_blinker_thr_data;

int init_status_blinker()
{
    int err;

    // Configure red and green leds as output+inactive
    if((err = gpio_pin_configure_dt(&led_r, GPIO_OUTPUT_INACTIVE)) != 0 ||
       (err = gpio_pin_configure_dt(&led_g, GPIO_OUTPUT_INACTIVE)) != 0)
    {
        return err;
    }

    // Set the led to blink to red -> we're not connected yet
    led_to_blink = &led_r;

    // Create and start the blinker thread with blink() acting as entry point
    k_thread_create(&status_blinker_thr_data, status_blinker_stack,
            K_THREAD_STACK_SIZEOF(status_blinker_stack),
            blink, NULL, NULL, NULL,
            STATUS_BLINKER_PRIORITY, 0, K_FOREVER);
    k_thread_start(&status_blinker_thr_data);
    return 0;
}

void blink(void)
{
    while(true)
    {
        // Lock the led mutex, toggle led, unlock mutex and go to sleep
        k_mutex_lock(&led_mutex, K_FOREVER);
        gpio_pin_toggle(led_to_blink->port, led_to_blink->pin);
        k_mutex_unlock(&led_mutex);
        k_msleep(STATUS_BLINKER_SLEEPTIME);
    }
}
```

## src/status_blinker.h
```c
#ifndef __STATUS_BLINKER_HPP__
#define __STATUS_BLINKER_HPP__

int init_status_blinker();
void blink(void);

#endif
```
